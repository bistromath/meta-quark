## conf/bblayers.conf.sample
```bitbake
# LAYER_CONF_VERSION is increased each time build/conf/bblayers.conf
# changes incompatibly
LCONF_VERSION = "6"

BBPATH = "${TOPDIR}:"
BBFILES ?= ""

BBLAYERS ?= " \
  ##COREBASE##/../meta-zedboard-adv7511 \
  ##COREBASE##/meta \
  ##COREBASE##/../meta-xilinx \
  ##COREBASE##/../meta-oe/meta-oe \
  ##COREBASE##/../meta-oe/meta-multimedia \
  ##COREBASE##/../meta-oe/meta-gnome \
  ##COREBASE##/../meta-oe/meta-networking \
  ##COREBASE##/../meta-oe/meta-python \
  ##COREBASE##/../meta-oe/meta-filesystems \
  ##COREBASE##/../meta-oe/meta-quark \
  "
```

## conf/layer.conf
```bitbake
# We have a conf and classes directory, add to BBPATH
BBPATH .= "${LAYERDIR}"

# We have recipes-* directories, add to BBFILES
BBFILES += "${LAYERDIR}/recipes-*/*/*.bb ${LAYERDIR}/recipes-*/*/*.bbappend"

#BBFILE_COLLECTIONS += "zedboard-adv7511"
#BBFILE_PATTERN_zedboard-adv7511 = "^${LAYERDIR}/"
#BBFILE_PRIORITY_zedboard-adv7511 = "1"

# This should only be incremented on significant changes that will
# cause compatibility issues with other layers
#LAYERVERSION_zedboard-adv7511 = "1"

#LAYERDEPENDS_zedboard-adv7511 = "core"
```
